/*
main.c file
编写者：小马  (Camel)
作者E-mail：375836945@qq.com
编译环境：MDK-Lite  Version: 4.23
初版时间: 2014-03-28
修改：tuyafei
功能：
1.遥控主函数入口
------------------------------------
*/

#include      "Config.h"			 //头文件包含


#define  R_Mode  Japan  //修改宏定义，切换遥控操作方式为美国手还是日本手
/******************日本手*********************
       Pitch                Throttle
         +                     +
         |                     |
     +---|---- Yaw         ----|---+ RoLL    
         |                     |
         |                     |
**********************************************/
/******************美国手*********************
      Throttle               Pitch
         +                     +
         |                     |
     +---|---- Yaw         ----|---+ RoLL    
         |                     |
         |                     |
**********************************************/
/******************中国手*********************
       Pitch                Throttle
         +                     +
         |                     |
     +---|---- Roll        ----|---+ Yaw    
         |                     |
         |                     |
**********************************************/
extern const u8 RX_ADDRESS1[RX_ADR_WIDTH];
int main(void)
{
	  SystemClock_HSI(9);    //系统时钟设置,9倍频，36M
    LedInit();						 //LED 初始化	
    Adc_Init();            //摇杆AD初始化
	  USART1_Config();
    NRF24L01_Init();       //无线模块初始化
 		TX_Mode();						 //发送模式
	  //选择1通道作为发射机
	  NRF24L01_CE=0;
		NRF24L01_Write_Buf(0x20+TX_ADDR,(u8*)RX_ADDRESS1,5);//写TX节点地址
		NRF24L01_Write_Buf(0X20+RX_ADDR_P0,(u8*)RX_ADDRESS1,5);//写RX1接收地址
		NRF24L01_CE=1;
    
	  TIM4_Init();           //定时器初始化,定时周期为1ms，1ms发送一次摇杆AD值
    KeyInit();             //按键初始化
    //TxBuf[30]=0xA5;        //对应遥控器，该位写0xA5,保证飞机能在开机的时候能收到一个完整的32字节的数据包       
/*******************************************************/
//以下为遥控解锁段         
/*******************************************************/
		do
	  {
			GetAD(R_Mode);//得到各路AD值并显示
			Led2=0;
		} while((Throttle>5)||(Yaw>5));//解锁条件：油门拉到最低，方向打到最右解锁

		Led2=1;
// 		TxBuf[28]=0;   //对应遥控器，该字节写0，使飞机跳过写参数那一步
// 		TxBuf[27]=0xA5;//解锁飞机
		TxBuf[31]=0xA5;//解锁成功，使能飞控
// /*******************************************************/
// //解锁完成
// /*******************************************************/
 
  while(1)
		{  
      GetAD(R_Mode);                            //得到各路AD值并显示
      if(Key2==0){TxBuf[10]=0xA5;Led3=1; }//按键子程序，用于设置一键操作，如一键翻滚，一键返航等
      else {TxBuf[10]=0;Led3=0;}
		}
}





